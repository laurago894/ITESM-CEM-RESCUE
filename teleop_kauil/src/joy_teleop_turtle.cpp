//Author: Laura Galindez Olascoaga
//This program subscribes to the data generated by the joystick and interfaces with Ros turtle for demo purposes

#include "ros/ros.h"
#include "std_msgs/String.h"
#include <sensor_msgs/Joy.h>
#include <stdio.h>
#include <turtlesim/Velocity.h>



void joyCallback(const sensor_msgs::Joy::ConstPtr& joy)
{

  int Y=0;
  int A=0;
  int B=0;
  int X=0;
  float trigg=0;
  float speed_t=0;

  ros::NodeHandle n;
  ros::Publisher joy_pub = n.advertise<turtlesim::Velocity>("turtle1/command_velocity", 1);

  turtlesim::Velocity vel;

  //saving button values in global variables 

  Y=joy->buttons[3];
  A=joy->buttons[0];
  B=joy->buttons[1];
  X=joy->buttons[2];
  trigg=joy->axes[5];
  
  speed_t=(trigg*127.5)-127.5;
  
  vel.linear=vel.angular=0;

 //forwards 
  if (A==0&&B==0&&X==0)
  {
   if (Y==1)
   {
    vel.linear=1.0;
   }
  }
  
  //backwards
    if (Y==0&&B==0&&X==0)
  {
   if (A==1)
   {
    vel.linear=-1.0;
   }
  }
  
  //turn right
    if (A==0&&Y==0&&X==0)
  {
   if (B==1)
   {
    vel.angular=1.0; 
   }
  }
  
    //turn left
    if (Y==0&&B==0&&A==0)
  {
   if (X==1)
   {
       vel.angular=-1.0;
 
   }
  }
 
 
  ros::Rate r(100);  
  while(n.ok()){

   ros::spinOnce(); 
  
  joy_pub.publish(vel);
  r.sleep();
  }

}



int main(int argc, char **argv)
{

ros::init(argc, argv, "joy_teleop_turtle");

  
  ros::NodeHandle n;

 
 
  ros::Subscriber joy_sub = n.subscribe<sensor_msgs::Joy>("joy", 10, joyCallback);

   ros::spin();


  return 0;
}

